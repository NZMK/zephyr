## drivers/sensor/opt3001/Kconfig
```kconfig
# OPT3001 light sensor configuration options

# Copyright (c) 2019 Actinius
# SPDX-License-Identifier: Apache-2.0

config OPT3001
	bool "OPT3001 Light Sensor"
	default y
	depends on DT_HAS_TI_OPT3001_ENABLED
	select I2C
	help
	  Enable driver for OPT3001 light sensors.

if OPT3001

choice
	prompt "Trigger Mode"
	default OPT3001_TRIGGER_NONE
	help
	  Specify the type of triggering to be used by the driver.

config OPT3001_TRIGGER_NONE
	bool "No Trigger"

config OPT3001_TRIGGER_GLOBAL_THREAD
	bool "Use global thread"
	depends on GPIO
	select OPT3001_TRIGGER

endchoice # Trigger Mode

config OPT3001_TRIGGER
	bool

endif # OPT3001
```

## dts/bindings/sensor/ti,opt3001.yaml
```yaml
# Copyright (c) 2019, Actinius
# SPDX-License-Identifier: Apache-2.0

description: Texas Instruments OPT3001 ambient light sensor

compatible: "ti,opt3001"

include: [sensor-device.yaml, i2c-device.yaml]

properties:
  int-gpios:
    type: phandle-array
    description: |
      The INT pin signals that a programmable interrupt function with upper and
      lower thresholds has been triggered. The pin is active-low open drain.
```
